## conf/layer.conf
```bitbake
# We have a conf and classes directory, add to BBPATH
BBPATH .= ":${LAYERDIR}"

BBFILE_COLLECTIONS += "meta-sstate-test"
BBFILE_PATTERN_meta-sstate-test = "^${LAYERDIR}/"
BBFILE_PATTERN_IGNORE_EMPTY_meta-sstate-test = "1"
BBFILE_PRIORITY_meta-sstate-test = "6"

LAYERDEPENDS_meta-sstate-test = "core"
LAYERSERIES_COMPAT_meta-sstate-test = "nanbield"

INHERIT += "sstatetest"
```
